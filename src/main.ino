/*
  لعبة ذاكرة الألوان 
  Color Memmory Game
  Start the game by pressing one of the four buttons. 
  When a button lights up, press the button to repeat the sequence. 
  The game is won after 10 rounds.
 */

#define CHOICE_OFF      0 
#define CHOICE_NONE     0 
#define CHOICE_RED   (1 << 0) // bit-shifting: assign a binary value to each color
#define CHOICE_GREEN (1 << 1)
#define CHOICE_BLUE  (1 << 2)
#define CHOICE_YELLOW (1 << 3)

#define LED_RED     10
#define LED_GREEN   3
#define LED_BLUE    13
#define LED_YELLOW  5

#define BUTTON_RED    9
#define BUTTON_GREEN  2
#define BUTTON_BLUE   12
#define BUTTON_YELLOW 6

#define BUZZER1  4 // push-pull: makes buzzer louder
#define BUZZER2  7

// Define game parameters
#define ROUNDS_TO_WIN      10 // 10 rounds to win
#define ENTRY_TIME_LIMIT   3000 // 3 seconds to press a button

// Game state variables
byte gameBoard[32]; // stores color sequence generated by arduino
byte gameRound = 0; // tracks the level/round

void setup()
{
  Serial.begin(9600); // Initialize Serial Communication to print to screen

  pinMode(BUTTON_RED, INPUT);
  pinMode(BUTTON_GREEN, INPUT);
  pinMode(BUTTON_BLUE, INPUT);
  pinMode(BUTTON_YELLOW, INPUT);

  pinMode(LED_RED, OUTPUT);
  pinMode(LED_GREEN, OUTPUT);
  pinMode(LED_BLUE, OUTPUT);
  pinMode(LED_YELLOW, OUTPUT);

  pinMode(BUZZER1, OUTPUT);
  pinMode(BUZZER2, OUTPUT);

  Serial.println("--- Game Ready! Press any button to start ---");
  play_winner(); // Say hello to the world
}

void loop()
{
  attractMode(); // Blink lights one-by-one while waiting for user to press a button

  Serial.println("\n--- NEW GAME STARTED ---");

  // Indicate the start of game play: all leds flash at the same time
  setLEDs(CHOICE_RED | CHOICE_GREEN | CHOICE_BLUE | CHOICE_YELLOW); 
  delay(1000);
  setLEDs(CHOICE_OFF); 
  delay(250);

  // Play memory game and handle result directly
  if (play_memory() == true) 
    play_winner(); 
  else 
    play_loser(); 
}

// Play the memory game ==>
boolean play_memory(void)
{
  randomSeed(millis()); // generate random starting point 
  gameRound = 0; 

  while (gameRound < ROUNDS_TO_WIN) 
  {
    add_to_moves(); // pick random color & add it to gameBoard memory (increments gameRound)

    // PRINT CURRENT ROUND TO SERIAL MONITOR
    Serial.print("Current Round: ");
    Serial.print(gameRound);
    Serial.print(" / ");
    Serial.println(ROUNDS_TO_WIN);

    playMoves(); // flash the sequence to player

    for (byte currentMove = 0 ; currentMove < gameRound ; currentMove++) // check for player input
    {
      byte choice = wait_for_button(); 

      if (choice == 0) {
        Serial.println("Time's up! You lost!");
        return false;  // if player pressed nothing ->  lose
      }
      if (choice != gameBoard[currentMove]) {
        Serial.println("Wrong button! Game Over!");
        return false; // if wrong button was pressed -> lose
      }
    }

    Serial.println("Great job! Moving to next round...\n");
    delay(1000); 
  }

  Serial.println("CONGRATULATIONS! YOU WON THE GAME!");
  return true; 
}

// Plays the current contents of the game moves
void playMoves(void)
{
  for (byte currentMove = 0 ; currentMove < gameRound ; currentMove++) 
  {
    toner(gameBoard[currentMove], 150);
    delay(150); 
  }
}

// Adds a new random button to the game sequence
void add_to_moves(void)
{
  byte newButton = random(0, 4); 

  if(newButton == 0) newButton = CHOICE_RED;
  else if(newButton == 1) newButton = CHOICE_GREEN;
  else if(newButton == 2) newButton = CHOICE_BLUE;
  else if(newButton == 3) newButton = CHOICE_YELLOW;

  gameBoard[gameRound++] = newButton; 
}

// Lights a given LED configuration
void setLEDs(byte leds)
{
  digitalWrite(LED_RED, (leds & CHOICE_RED) != 0 ? HIGH : LOW);
  digitalWrite(LED_GREEN, (leds & CHOICE_GREEN) != 0 ? HIGH : LOW);
  digitalWrite(LED_BLUE, (leds & CHOICE_BLUE) != 0 ? HIGH : LOW);
  digitalWrite(LED_YELLOW, (leds & CHOICE_YELLOW) != 0 ? HIGH : LOW);
}

// Wait for a button to be pressed
byte wait_for_button(void) 
{
  long startTime = millis();

  while ( (millis() - startTime) < ENTRY_TIME_LIMIT)
  {
    byte button = checkButton();

    if (button != CHOICE_NONE)
    { 
      toner(button, 150); 

      while(checkButton() != CHOICE_NONE) ;  

      delay(10); 
      return button;
    }
  }
  return CHOICE_NONE; 
}

// Returns the active button state
byte checkButton(void)
{
  if (digitalRead(BUTTON_RED) == 1) return(CHOICE_RED); 
  else if (digitalRead(BUTTON_GREEN) == 1) return(CHOICE_GREEN); 
  else if (digitalRead(BUTTON_BLUE) == 1) return(CHOICE_BLUE); 
  else if (digitalRead(BUTTON_YELLOW) == 1) return(CHOICE_YELLOW);

  return(CHOICE_NONE); 
}

// Light an LED and play tone
void toner(byte which, int buzz_length_ms)
{
  setLEDs(which); 

  switch(which) 
  {
  case CHOICE_RED:
    buzz_sound(buzz_length_ms, 1136); 
    break;
  case CHOICE_GREEN:
    buzz_sound(buzz_length_ms, 568); 
    break;
  case CHOICE_BLUE:
    buzz_sound(buzz_length_ms, 851); 
    break;
  case CHOICE_YELLOW:
    buzz_sound(buzz_length_ms, 638); 
    break;
  }

  setLEDs(CHOICE_OFF); 
}

// Toggle buzzer for audio feedback
void buzz_sound(int buzz_length_ms, int buzz_delay_us)
{
  long buzz_length_us = buzz_length_ms * (long)1000;

  while (buzz_length_us > (buzz_delay_us * 2))
  {
    buzz_length_us -= buzz_delay_us * 2; 

    digitalWrite(BUZZER1, LOW);
    digitalWrite(BUZZER2, HIGH);
    delayMicroseconds(buzz_delay_us);

    digitalWrite(BUZZER1, HIGH);
    digitalWrite(BUZZER2, LOW);
    delayMicroseconds(buzz_delay_us);
  }
}

// Play the winner sound and lights
void play_winner(void)
{
  setLEDs(CHOICE_GREEN | CHOICE_BLUE);
  winner_sound();
  setLEDs(CHOICE_RED | CHOICE_YELLOW);
  winner_sound();
  setLEDs(CHOICE_GREEN | CHOICE_BLUE);
  winner_sound();
  setLEDs(CHOICE_RED | CHOICE_YELLOW);
  winner_sound();
}

// Generates winner frequencies
void winner_sound(void)
{
  for (byte x = 250 ; x > 70 ; x--)
  {
    for (byte y = 0 ; y < 3 ; y++)
    {
      digitalWrite(BUZZER2, HIGH);
      digitalWrite(BUZZER1, LOW);
      delayMicroseconds(x);

      digitalWrite(BUZZER2, LOW);
      digitalWrite(BUZZER1, HIGH);
      delayMicroseconds(x);
    }
  }
}

// Play the loser sound/lights
void play_loser(void)
{
  setLEDs(CHOICE_RED | CHOICE_GREEN);
  buzz_sound(255, 1500);

  setLEDs(CHOICE_BLUE | CHOICE_YELLOW);
  buzz_sound(255, 1500);

  setLEDs(CHOICE_RED | CHOICE_GREEN);
  buzz_sound(255, 1500);

  setLEDs(CHOICE_BLUE | CHOICE_YELLOW);
  buzz_sound(255, 1500);
}

// Attract mode display sequence
void attractMode(void)
{
  while(1) 
  {
    setLEDs(CHOICE_RED);
    delay(100);
    if (checkButton() != CHOICE_NONE) return;

    setLEDs(CHOICE_BLUE);
    delay(100);
    if (checkButton() != CHOICE_NONE) return;

    setLEDs(CHOICE_GREEN);
    delay(100);
    if (checkButton() != CHOICE_NONE) return;

    setLEDs(CHOICE_YELLOW);
    delay(100);
    if (checkButton() != CHOICE_NONE) return;
  }
}
